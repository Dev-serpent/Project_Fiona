/*
  CamComs ESP32 sender payload.

  Direction:
    ESP32 -> encrypted/encoded HTTP POST -> host

  Hardware Requirements:
    - ESP32 (S2, S3, C3, C6, etc.)
    - Built-in Wi-Fi
    - MbedTLS (built-in to ESP-IDF / Arduino ESP32 core)
    - libsodium (built-in to Arduino ESP32 core)
    - ArduinoJson library (V6 or V7)

  Fill the configuration block below with values generated by:
    fiona camcoms keygen --device-id host --private-out host.private.json --public-out host.public.json
    fiona camcoms keygen --device-id esp32 --private-out esp32.private.json --public-out esp32.public.json

  The envelope shape matches CamComs.encryption on the Python host.
*/

#include <Arduino.h>
#include <ArduinoJson.h>
#include <HTTPClient.h>
#include <WiFi.h>
#include <time.h>

// Crypto headers from ESP-IDF / mbedTLS
#include <mbedtls/aes.h>
#include <mbedtls/gcm.h>
#include <mbedtls/hkdf.h>
#include <mbedtls/md.h>
#include <mbedtls/base64.h>
#include <sodium.h>

// ---------------- Configuration ----------------

static const char *WIFI_SSID = "YOUR_WIFI_SSID";
static const char *WIFI_PASSWORD = "YOUR_WIFI_PASSWORD";

static const char *HOST_URL = "http://192.168.1.10:8080/";

static const char *ESP32_DEVICE_ID = "esp32";
static const char *HOST_DEVICE_ID = "host";

static const char *HOST_ENCRYPTION_PUBLIC_KEY_B64 = "PASTE_HOST_PUBLIC_ENCRYPTION_KEY";
static const char *ESP32_SIGNING_PRIVATE_KEY_B64 = "PASTE_ESP32_PRIVATE_SIGNING_KEY";

static const char *KEY_INFO = "fiona.camcoms.v1";

static const char *NTP_SERVER = "pool.ntp.org";

// ---------------- Encoding Helpers ----------------

String base64UrlEncode(const uint8_t *data, size_t len) {
  // Manual Base64URL encoding (RFC 4648)
  static const char table[] = "ABCDEFGHIJKLMNOPQRSTUVWXYZabcdefghijklmnopqrstuvwxyz0123456789-_";
  String out;
  out.reserve(((len + 2) / 3) * 4);

  for (size_t i = 0; i < len; i += 3) {
    uint32_t block = ((uint32_t)data[i]) << 16;
    if (i + 1 < len) block |= ((uint32_t)data[i + 1]) << 8;
    if (i + 2 < len) block |= data[i + 2];

    out += table[(block >> 18) & 0x3f];
    out += table[(block >> 12) & 0x3f];
    // Base64URL typically omits padding, but Python's urlsafe_b64encode adds it by default.
    // We add it here for maximum compatibility with strict decoders.
    out += (i + 1 < len) ? table[(block >> 6) & 0x3f] : '=';
    out += (i + 2 < len) ? table[block & 0x3f] : '=';
  }

  return out;
}

String base64UrlEncodeString(const String &text) {
  return base64UrlEncode((const uint8_t *)text.c_str(), text.length());
}

bool base64UrlDecode(const char *encoded, uint8_t *out, size_t outLen, size_t *actualLen) {
  String s = String(encoded);
  s.replace("-", "+");
  s.replace("_", "/");
  int res = mbedtls_base64_decode(out, outLen, actualLen, (const unsigned char *)s.c_str(), s.length());
  return res == 0;
}

String jsonCanonicalForAad(
  const String &createdAt,
  const String &ephemeralPublicKey,
  const String &messageId,
  const String &messageType,
  const String &nonce,
  const String &recipient,
  const String &salt,
  const String &sender,
  const String &senderSigningPublicKey
) {
  // Matches Python json.dumps(..., sort_keys=True, separators=(",", ":"))
  // Fields in alphabetical order:
  // created_at, ephemeral_public_key, kind, message_id, message_type, nonce, recipient, salt, sender, sender_signing_public_key, version
  String json = "{";
  json += "\"created_at\":" + createdAt + ",";
  json += "\"ephemeral_public_key\":\"" + ephemeralPublicKey + "\",";
  json += "\"kind\":\"camcoms.encrypted\",";
  json += "\"message_id\":\"" + messageId + "\",";
  json += "\"message_type\":\"" + messageType + "\",";
  json += "\"nonce\":\"" + nonce + "\",";
  json += "\"recipient\":\"" + recipient + "\",";
  json += "\"salt\":\"" + salt + "\",";
  json += "\"sender\":\"" + sender + "\",";
  json += "\"sender_signing_public_key\":\"" + senderSigningPublicKey + "\",";
  json += "\"version\":1";
  json += "}";
  return json;
}

String jsonCanonicalForSignature(const String &aadJson, const String &ciphertext) {
  // Python sort_keys=True: "ciphertext" comes before "created_at" alphabetically.
  // So ciphertext must be the FIRST key in the signed JSON.
  String json = "{\"ciphertext\":\"" + ciphertext + "\",";
  json += aadJson.substring(1); // Skip the opening '{' of AAD
  return json;
}

String randomHexId() {
  uint8_t bytes[16];
  for (size_t i = 0; i < sizeof(bytes); ++i) bytes[i] = (uint8_t)esp_random();
  char output[33];
  for (size_t i = 0; i < sizeof(bytes); ++i) {
    sprintf(output + (i * 2), "%02x", bytes[i]);
  }
  output[32] = '\0';
  return String(output);
}

// ---------------- Crypto Adapter ----------------

bool base64UrlDecode32(const char *encoded, uint8_t out[32]) {
  size_t actualLen = 0;
  return base64UrlDecode(encoded, out, 32, &actualLen) && actualLen == 32;
}

bool deriveSenderSigningPublicKey(const char *signingPrivateKeyB64, uint8_t outPublicKey[32]) {
  uint8_t secretKey[64]; // libsodium ed25519 secret key is 64 bytes (seed + pubkey)
  size_t actualLen = 0;
  if (!base64UrlDecode(signingPrivateKeyB64, secretKey, 64, &actualLen)) return false;
  
  if (actualLen == 32) {
    uint8_t dummySk[64];
    return crypto_sign_ed25519_seed_keypair(outPublicKey, dummySk, secretKey) == 0;
  } else if (actualLen == 64) {
    memcpy(outPublicKey, secretKey + 32, 32);
    return true;
  }
  return false;
}

bool generateEphemeralX25519Keypair(uint8_t privateKey[32], uint8_t publicKey[32]) {
  return crypto_box_keypair(publicKey, privateKey) == 0;
}

bool encryptForHost(
  const uint8_t *plaintext,
  size_t plaintextLen,
  const uint8_t hostPublicKey[32],
  const uint8_t ephemeralPrivateKey[32],
  const uint8_t *aad,
  size_t aadLen,
  uint8_t salt[16],
  uint8_t nonce[12],
  uint8_t *ciphertextWithTag,
  size_t *ciphertextWithTagLen
) {
  uint8_t sharedSecret[32];
  if (crypto_scalarmult(sharedSecret, ephemeralPrivateKey, hostPublicKey) != 0) return false;

  uint8_t aesKey[32];
  // HKDF-SHA256 (Hardware accelerated if available)
  if (mbedtls_hkdf(mbedtls_md_info_from_type(MBEDTLS_MD_SHA256), salt, 16, 
                   shared_secret, 32, (const unsigned char *)KEY_INFO, strlen(KEY_INFO), 
                   aesKey, 32) != 0) return false;

  mbedtls_gcm_context gcm;
  mbedtls_gcm_init(&gcm);
  // AES-GCM (Hardware accelerated if available)
  if (mbedtls_gcm_setkey(&gcm, MBEDTLS_CIPHER_ID_AES, aesKey, 256) != 0) {
    mbedtls_gcm_free(&gcm);
    return false;
  }

  int res = mbedtls_gcm_crypt_and_tag(&gcm, MBEDTLS_GCM_ENCRYPT, plaintextLen, 
                                     nonce, 12, aad, aadLen, 
                                     plaintext, ciphertextWithTag, 16, 
                                     ciphertextWithTag + plaintextLen);
  mbedtls_gcm_free(&gcm);
  
  if (res == 0) {
    *ciphertextWithTagLen = plaintextLen + 16;
    return true;
  }
  return false;
}

bool signEnvelope(
  const uint8_t *canonicalEnvelope,
  size_t canonicalEnvelopeLen,
  const char *esp32SigningPrivateKeyB64,
  uint8_t signature[64]
) {
  uint8_t secretKey[64];
  size_t actualLen = 0;
  if (!base64UrlDecode(esp32SigningPrivateKeyB64, secretKey, 64, &actualLen)) return false;

  if (actualLen == 32) {
    uint8_t pk[32];
    uint8_t sk[64];
    crypto_sign_ed25519_seed_keypair(pk, sk, secretKey);
    return crypto_sign_ed25519_detached(signature, NULL, canonicalEnvelope, canonicalEnvelopeLen, sk) == 0;
  } else if (actualLen == 64) {
    return crypto_sign_ed25519_detached(signature, NULL, canonicalEnvelope, canonicalEnvelopeLen, secretKey) == 0;
  }
  return false;
}

// ---------------- Envelope + HTTP ----------------

String buildEncryptedEnvelope(const String &instruction) {
  uint8_t hostPublicKey[32];
  uint8_t senderSigningPublicKey[32];
  uint8_t ephemeralPrivateKey[32];
  uint8_t ephemeralPublicKey[32];
  uint8_t salt[16];
  uint8_t nonce[12];
  uint8_t ciphertextWithTag[512];
  uint8_t signature[64];
  size_t ciphertextWithTagLen = 0;

  if (!base64UrlDecode32(HOST_ENCRYPTION_PUBLIC_KEY_B64, hostPublicKey)) {
    Serial.println("Error: Invalid host public key.");
    return "";
  }
  if (!deriveSenderSigningPublicKey(ESP32_SIGNING_PRIVATE_KEY_B64, senderSigningPublicKey)) {
    Serial.println("Error: Invalid ESP32 signing private key.");
    return "";
  }

  for (int i=0; i<16; i++) salt[i] = (uint8_t)esp_random();
  for (int i=0; i<12; i++) nonce[i] = (uint8_t)esp_random();

  if (!generateEphemeralX25519Keypair(ephemeralPrivateKey, ephemeralPublicKey)) {
    Serial.println("Error: Ephemeral keypair generation failed.");
    return "";
  }

  // Get current Unix timestamp (requires NTP sync)
  time_t now;
  time(&now);
  String createdAt = String((uint32_t)now);
  
  String messageId = randomHexId();
  String senderSigningPublicKeyB64 = base64UrlEncode(senderSigningPublicKey, sizeof(senderSigningPublicKey));
  String ephemeralPublicKeyB64 = base64UrlEncode(ephemeralPublicKey, sizeof(ephemeralPublicKey));
  String saltB64 = base64UrlEncode(salt, sizeof(salt));
  String nonceB64 = base64UrlEncode(nonce, sizeof(nonce));

  String aadJson = jsonCanonicalForAad(
    createdAt,
    ephemeralPublicKeyB64,
    messageId,
    "instruction",
    nonceB64,
    HOST_DEVICE_ID,
    saltB64,
    ESP32_DEVICE_ID,
    senderSigningPublicKeyB64
  );

  if (!encryptForHost(
        (const uint8_t *)instruction.c_str(),
        instruction.length(),
        hostPublicKey,
        ephemeralPrivateKey,
        (const uint8_t *)aadJson.c_str(),
        aadJson.length(),
        salt,
        nonce,
        ciphertextWithTag,
        &ciphertextWithTagLen)) {
    Serial.println("Error: Encryption failed.");
    return "";
  }

  String ciphertextB64 = base64UrlEncode(ciphertextWithTag, ciphertextWithTagLen);
  String canonicalSignedJson = jsonCanonicalForSignature(aadJson, ciphertextB64);

  if (!signEnvelope(
        (const uint8_t *)canonicalSignedJson.c_str(),
        canonicalSignedJson.length(),
        ESP32_SIGNING_PRIVATE_KEY_B64,
        signature)) {
    Serial.println("Error: Signing failed.");
    return "";
  }

  // ArduinoJson 6/7 compatibility
  StaticJsonDocument<2048> envelope;
  envelope["version"] = 1;
  envelope["kind"] = "camcoms.encrypted";
  envelope["message_id"] = messageId;
  envelope["message_type"] = "instruction";
  envelope["created_at"] = (uint32_t)now;
  envelope["sender"] = ESP32_DEVICE_ID;
  envelope["recipient"] = HOST_DEVICE_ID;
  envelope["sender_signing_public_key"] = senderSigningPublicKeyB64;
  envelope["ephemeral_public_key"] = ephemeralPublicKeyB64;
  envelope["salt"] = saltB64;
  envelope["nonce"] = nonceB64;
  envelope["ciphertext"] = ciphertextB64;
  envelope["signature"] = base64UrlEncode(signature, sizeof(signature));

  String envelopeJson;
  serializeJson(envelope, envelopeJson);
  return base64UrlEncodeString(envelopeJson);
}

bool sendInstructionToHost(const String &instruction) {
  if (WiFi.status() != WL_CONNECTED) {
    Serial.println("WiFi not connected, skipping send.");
    return false;
  }

  String encodedEnvelope = buildEncryptedEnvelope(instruction);
  if (encodedEnvelope.length() == 0) return false;

  HTTPClient http;
  http.begin(HOST_URL);
  http.addHeader("Content-Type", "text/plain; charset=ascii");
  http.setTimeout(5000);
  
  int status = http.POST(encodedEnvelope);
  String response = http.getString();
  http.end();

  if (status == 200) {
    Serial.print("Success: Host response: ");
    Serial.println(response);
    return true;
  } else {
    Serial.print("Error: Host returned status ");
    Serial.print(status);
    Serial.print(": ");
    Serial.println(response);
    return false;
  }
}

// ---------------- Lifecycle ----------------

void syncTime() {
  Serial.print("Syncing time with NTP...");
  configTime(0, 0, NTP_SERVER);
  struct tm timeinfo;
  while (!getLocalTime(&timeinfo)) {
    Serial.print(".");
    delay(500);
  }
  Serial.println(" Done.");
}

void setup() {
  Serial.begin(115200);
  
  if (sodium_init() == -1) {
      Serial.println("libsodium init failed");
      return;
  }

  WiFi.begin(WIFI_SSID, WIFI_PASSWORD);
  Serial.print("Connecting to WiFi...");
  int attempts = 0;
  while (WiFi.status() != WL_CONNECTED && attempts < 40) {
    delay(500);
    Serial.print(".");
    attempts++;
  }
  
  if (WiFi.status() == WL_CONNECTED) {
    Serial.println(" Connected.");
    Serial.print("IP: ");
    Serial.println(WiFi.localIP());
    syncTime();
  } else {
    Serial.println(" Connection failed.");
  }

  // Example: Initial "Hello" message
  sendInstructionToHost("{\"keys\":[\"alt\",\"s\"],\"type\":\"press\",\"version\":1}");
}

void loop() {
  // Reconnection logic
  if (WiFi.status() != WL_CONNECTED) {
    Serial.println("WiFi lost. Reconnecting...");
    WiFi.disconnect();
    WiFi.begin(WIFI_SSID, WIFI_PASSWORD);
    
    int attempts = 0;
    while (WiFi.status() != WL_CONNECTED && attempts < 20) {
      delay(500);
      attempts++;
    }
    
    if (WiFi.status() == WL_CONNECTED) {
      Serial.println("Reconnected.");
      syncTime();
    }
  }

  // Application logic here (e.g. read button and send command)
  delay(10000);
}

